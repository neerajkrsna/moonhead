## meta-coreos/conf/distro/coreos.conf
```bitbake
require conf/distro/poky.conf

DISTRO = "coreos"
DISTRO_NAME = "CORE-OS Prototype"
```

## meta-coreos/conf/layer.conf
```bitbake
BBPATH .= ":${LAYERDIR}"
BBFILES += "${LAYERDIR}/recipes-*/*/*.bb ${LAYERDIR}/recipes-*/*/*.bbappend"

BBFILE_COLLECTIONS += "coreos"
BBFILE_PATTERN_coreos = "^${LAYERDIR}/"
BBFILE_PRIORITY_coreos = "6"

LAYERDEPENDS_coreos = "core yocto"
LAYERSERIES_COMPAT_coreos = "wrynose"
```
